#include <Wire.h>
#include <MPU6050_tockn.h>
#include <U8g2lib.h>
#include <SPI.h>

MPU6050 mpu6050(Wire);

//INIZIO SCHERMO

U8G2_SSD1309_128X64_NONAME0_1_4W_HW_SPI u8g2(U8G2_R0, /* cs=*/ 6, /* dc=*/ 7, /* reset=*/ 12);

const uint8_t IMG_W = 128;
const uint8_t IMG_H = 64;

extern const unsigned char Felice1[] PROGMEM;
extern const unsigned char Felice2[] PROGMEM;
extern const unsigned char Triste1[] PROGMEM;
extern const unsigned char Triste2[] PROGMEM;
extern const unsigned char Amore1[] PROGMEM;
extern const unsigned char Amore2[] PROGMEM;
extern const unsigned char Rabbia1[] PROGMEM;
extern const unsigned char Rabbia2[] PROGMEM;
extern const unsigned char Sonno1[] PROGMEM;
extern const unsigned char Sonno2[] PROGMEM;
extern const unsigned char Lettera1[] PROGMEM;
extern const unsigned char Lettera2[] PROGMEM;
extern const unsigned char Stordimento1[] PROGMEM;
extern const unsigned char Stordimento2[] PROGMEM;
extern const unsigned char Normal1[] PROGMEM;
extern const unsigned char Normal2[] PROGMEM;

unsigned long FaceAuxTime = 0;
bool expr = 0;
//int exprDir = 1;

//PIEZO
#define PIEZP 2

//INIZIO FEEDBACKS

//INIZIO IMU
float accelX, accelY, accelZ; 
float gyroX, gyroY, gyroZ;    
float totalMovementAccel;     

//INIZIO <3
#define PR1P A2
#define PR2P A1
#define CaressTR 200

unsigned long CaressS = 0;
bool CaressMaybe = false;

//INIZIO :)
const float SHAKE_PEAK_THRESHOLD = 0.8;       
const unsigned long SHAKE_WINDOW_MS = 1500;   
unsigned long tN_shake = 0, tV_shake = 0, dN_shake = 0, dV_shake = 0;
bool wasAboveThreshold_shake = false; 

//INIZIO :(
const float LAY_DOWN_Z_THRESHOLD = 0.5;   
const float STILL_MOVEMENT_THRESHOLD = 0.6;
const float STILL_GYRO_THRESHOLD = 12.0;
const unsigned long SAD_STATE_DURATION_MS = 1000; 
bool isPotentiallySad = false;
unsigned long sadStateStartTime = 0;

//INIZIO >:o 
const float LIFT_THRESHOLD = 0.8, DROP_THRESHOLD = 0.8;

bool liftf = false; //variable to see if the lift is fast enough
bool dropf = false; //idem
unsigned long startStill = 0;
unsigned long startLift = 0;
unsigned long startDrop = 0;
unsigned long startStill_II = 0;

enum SlamStates {
  WAIT_STILL,
  STILL,
  LIFT,
  DROP,
  STILL_II,
};

SlamStates SlamState = WAIT_STILL;


//INIZIO PROXIMITY
#define PROXP A0
int unsigned Distance = 0;

//STATE MACHINE (main one)
enum State {
  STATE_IDLE,
  STATE_MUST_DELIVER,
  STATE_DELIVERY,
  STATE_WAITING_FOR_FEEDBACK,
  STATE_WAITING_FOR_RESPONSE,
};

State currentState = STATE_IDLE;

//STATE MACHINE THINGS
unsigned long StateAuxTime = 0;
String messaggio = "";
unsigned int feedbackType = 0;






//--------------------------------SETUP-------------------------------

void setup() {
  Serial.begin(9600);
  while (!Serial);

	//PIEZO
	pinMode(PIEZP, OUTPUT);

	//SETUP PRESSIONE
	pinMode(PR1P,INPUT);
	pinMode(PR2P,INPUT);

  //SETUP IMU
  Wire.begin();
  mpu6050.begin();

  Serial.println(F("Calibrazione giroscopio..."));
  mpu6050.calcGyroOffsets(true);
  Serial.println(F("Calibrazione completata!"));

  //SETUP SCHERMO
  messaggio.reserve(110); 
  u8g2.begin();
	u8g2.sendF("c", 0xa6);
  u8g2.setContrast(200);
}





//--------------------------------LOOP-------------------------------

void loop() {
	
  switch (currentState) {
		
    case STATE_IDLE:

			if (millis() - FaceAuxTime > 300) {

				if (expr == 0) {
					drawFrame(29, 9, 75, 37, Sonno1);
					expr++;
				} else if (expr == 1) {
					drawFrame(29,5,82,43,Sonno2);
					expr = 0;
				} 
				FaceAuxTime = millis();
			}




			checkProtoPieSerial("print");
			if (messaggio != "") {
        currentState = STATE_MUST_DELIVER;
				u8g2.sendF("c", 0xa7); //verde
				drawFrame(29,9,70,45,Normal1);
				expr = 0;
				FaceAuxTime = millis();
      }
      break;



    case STATE_MUST_DELIVER:
			normalFace();
			

      Distance = analogRead(PROXP);

      if (Distance > 220) {
        currentState = STATE_DELIVERY;
      }
      break;

  

    case STATE_DELIVERY:
			u8g2.sendF("c", 0xa6);//nero per lettera
			drawFrame(39,20,49,23,Lettera1);

			tone(PIEZP, 1047, 60);  
  		delay(80);
  		tone(PIEZP, 1568, 60);  
  		delay(80);
  		tone(PIEZP, 2093, 120); 
  		delay(150);
  		noTone(PIEZP);

			drawFrame(39,14,49,29,Lettera2);
			delay(800);
      write(messaggio, 1);
			Serial.println(F("force||"));
      delay(10000);

			messaggio = "";
      currentState = STATE_WAITING_FOR_FEEDBACK;
      u8g2.sendF("c", 0xa7); //verde
			drawFrame(29,9,70,45,Normal1);
			expr = 0;
			FaceAuxTime = millis();
			StateAuxTime = millis();
      break;



    case STATE_WAITING_FOR_FEEDBACK:
			normalFace();


      if (millis() - StateAuxTime > 30000) {
        Serial.println(F("action||null"));
				returnToIdle();
      }

			detectFeedback();
			if (feedbackType > 0) {
				currentState = STATE_WAITING_FOR_RESPONSE;
      	StateAuxTime = millis();
				drawFrame(29,9,70,39,Stordimento1);
				tone(PIEZP, 1568, 60);  
  			delay(80);
  			noTone(PIEZP);
				feedbackType = 0;
			}
      break;



    case STATE_WAITING_FOR_RESPONSE:

			if (millis() - StateAuxTime < 3000) {
				if (millis() - FaceAuxTime > 600) {
					if (expr == 0) {
						drawFrame(29,9,70,39,Stordimento1);
						expr++;
						FaceAuxTime = millis();
					} else if (expr == 1) {
						drawFrame(29,9,70,39,Stordimento2);
						expr = 0;
						FaceAuxTime = millis();
					}
				}
      } else if (millis() - StateAuxTime > 3000) {
				normalFace();
			}
			
			checkProtoPieSerial("mood");
			if (messaggio != "") {
    		feedbackType = messaggio.toInt();
				if (feedbackType == 1) {
					for (int i = 0; i < 12; i++) {
						drawFrame(29, 9, 70, 45, Amore1);
            delay(300);
            drawFrame(29, 9, 70, 45, Amore2);
            tone(PIEZP, 1318, 80);
            delay(100);
            tone(PIEZP, 1568, 100);
            delay(100);
					}
				} else if (feedbackType == 2) {
					for (int i = 0; i < 12; i++) {
						drawFrame(24,9,80,45,Felice1);
            delay(300);
            drawFrame(22,9,86,45,Felice2);
            tone(PIEZP, 1318, 80);
            delay(100);
            tone(PIEZP, 1568, 100);
            delay(100);
					}
				} else if (feedbackType == 3) {
					for (int i = 0; i < 6; i++) {
						drawFrame(29, 8, 70, 47, Triste1);
            delay(500);
            drawFrame(29, 8, 70, 49, Triste2);
            tone(PIEZP, 330, 200);
            delay(250);
            tone(PIEZP, 261, 400);
            delay(200);
					}
				} else if (feedbackType == 4) {
					for (int i = 0; i < 20; i++) {
						drawFrame(29, 5, 83, 47, Rabbia1);
            delay(200);
            drawFrame(29, 7, 78, 45, Rabbia2);
            tone(PIEZP, 110, 80);
            delay(50);
            tone(PIEZP, 123, 150);
            delay(50);
					}
				}
			returnToIdle();
			}

      if (millis() - StateAuxTime > 30000) {
        returnToIdle();
      }
      break;

  }
  delay(20); 
}



//--------------------------------FUNZIONI E ALTRO-------------------------------

//PROTOPIE
void checkProtoPieSerial(const char* idCercato) {
    if (Serial.available() > 0) { 
        Serial.setTimeout(50); 
        messaggio = Serial.readStringUntil('\0');//versiona compatta
        int delimiterIndex = messaggio.indexOf("||");
        if (delimiterIndex != -1) {
            if (messaggio.startsWith(idCercato)) {
                messaggio.remove(0, strlen(idCercato) + 2);
            } 
            else {
                messaggio = "";//pulizia
            }
        } else {
            messaggio = "";//ulizia
        }
        while(Serial.available() > 0) { 
					Serial.read(); 
				}
    }
}


//COMODITA MACCHINA STATI
void returnToIdle () {
			currentState = STATE_IDLE;
			messaggio = "";
			expr = 0;
			feedbackType = 0;
			FaceAuxTime = millis();
			drawFrame(29, 9, 75, 37, Sonno1);
			u8g2.sendF("c", 0xa6);
			Serial.println(F("sleep||"));
}


//FUNZIONE LETTURA IMU
void readSensors() {
  mpu6050.update();
  accelX = mpu6050.getAccX();
  accelY = mpu6050.getAccY();
  accelZ = mpu6050.getAccZ();
  gyroX = mpu6050.getGyroX();
  gyroY = mpu6050.getGyroY();
  gyroZ = mpu6050.getGyroZ();

  float totalAccelMagnitude = sqrt(sq(accelX) + sq(accelY) + sq(accelZ));
  totalMovementAccel = abs(totalAccelMagnitude - 1.0);


  // DEBUG :/
  /*
  Serial.print("Acc: "); Serial.print(totalMovementAccel);
  Serial.print(" | Z: "); Serial.print(accelZ);
  Serial.print(" | GyX: "); Serial.print(gyroX);
  Serial.print(" | Still: "); Serial.println(wasStillRecently ? "TRUE" : "FALSE");
  */
}


//FUNZIONI SCHERMO

//FUNZIONE DI DISEGNO BITMAP
void drawFrame(int x, int y, int w, int h, const unsigned char *bmp) {
  u8g2.firstPage();
  do {
    u8g2.drawXBMP(x, y, w, h, bmp);
  } while (u8g2.nextPage());
}

void normalFace() {
	if ((millis() - FaceAuxTime > 3500)||((millis() - FaceAuxTime > 100)&&(expr == 0))) {
		if (expr == 0) {
			drawFrame(29,9,70,45,Normal1);
			expr++;
		} else if (expr == 1) {
			drawFrame(29,9,70,45,Normal2);
			expr = 0;
		}
		FaceAuxTime = millis();
	}
}

//FUNZIONE DI SCRITTURA, spaziata
void write(const String &text, int stepSize) {
  u8g2.setFont(u8g2_font_minuteconsole_tr);
  int totalLength = text.length();
  int16_t lineHeight = u8g2.getAscent() - u8g2.getDescent();

  for (int charLimit = 0; charLimit <= totalLength; charLimit += stepSize) {
    
    u8g2.firstPage();
    do {
      int16_t currentX = 0;
      int16_t currentY = u8g2.getAscent();
      int charsPrinted = 0;
      const char* p = text.c_str();

      while (*p != '\0' && currentY < u8g2.getDisplayHeight() && charsPrinted < charLimit) {
        const char* end = p;
        while (*end != ' ' && *end != '\0') end++;
        int wordLen = end - p;

        char wordBuffer[21];
        if (wordLen > 20) wordLen = 20;
        strncpy(wordBuffer, p, wordLen);
        wordBuffer[wordLen] = '\0';

        int16_t wordWidth = u8g2.getStrWidth(wordBuffer);

        if (currentX + wordWidth > u8g2.getDisplayWidth() && currentX != 0) {
          currentX = 0;
          currentY += lineHeight;
        }

        if (currentY < u8g2.getDisplayHeight()) {
          u8g2.setCursor(currentX, currentY);
          for (int i = 0; i < wordLen; i++) {
            if (charsPrinted < charLimit) {
              u8g2.print(wordBuffer[i]);
              charsPrinted++;
            }
          }
          currentX += wordWidth + u8g2.getStrWidth(" ");
          charsPrinted++;
        }
        
        p = end;
        if (*p == ' ') p++;
      }
    } while (u8g2.nextPage());

    //PAUSE VARIABILI
    int pausaDinamica = 10; 

    if (charLimit > 0 && charLimit <= totalLength) {
      char lastChar = text[charLimit - 1];

      if (lastChar == ' ') {
        pausaDinamica = 300; 
      } 
      else if (lastChar == '.' || lastChar == '!' || lastChar == '?') {
        pausaDinamica = 500; 
      }
      else if (lastChar == ',') {
        pausaDinamica = 250; 
      }
			
			if ((lastChar != ' ')&&(lastChar != ' ,')&&(lastChar != '.')&&(lastChar != '?')&&(lastChar != '!')) {
        int frequency = 400 + (lastChar * 10);
        tone(PIEZP, frequency, 20);
      }
    }

    delay(pausaDinamica); 
  }
}

//FUNZIONI <3
void detectCaress () {
  unsigned int PR1 = analogRead(PR1P);
  unsigned int PR2 = analogRead(PR2P);
  if ((PR1 > CaressTR) && (!CaressMaybe)) {
    CaressS = millis();
    CaressMaybe = true;
  }
  if ((CaressMaybe) && (PR1 < CaressTR) && (PR2 > CaressTR)) {
    CaressMaybe = false;
    Serial.println(F("action||1"));
		feedbackType = 1;
  }
  if ((CaressMaybe) && (millis() - CaressS > 500)) {
    CaressMaybe = false;
  }
}

//FUNZIONI :)
void detectShake() {
  bool isCurrentlyAbove = (totalMovementAccel > SHAKE_PEAK_THRESHOLD);

  if (isCurrentlyAbove && !wasAboveThreshold_shake && (millis() - tN_shake > 300)) {
    dV_shake = dN_shake;
    tV_shake = tN_shake;
    tN_shake = millis();

    if (tV_shake > 0) {
      dN_shake = tN_shake - tV_shake;
    }

    if (dV_shake > 0 && dN_shake > 0 && (dN_shake + dV_shake < SHAKE_WINDOW_MS)) {
      Serial.println(F("action||2"));
      tN_shake = 0; tV_shake = 0; dN_shake = 0; dV_shake = 0;
			feedbackType = 2;
    }
  }
  
  wasAboveThreshold_shake = isCurrentlyAbove;
}


//FUNZIONI :(
void detectLayDownState() {
  bool isLayingDownAndStill = (abs(accelZ) < LAY_DOWN_Z_THRESHOLD &&
                               totalMovementAccel < STILL_MOVEMENT_THRESHOLD &&
                               abs(gyroX) < STILL_GYRO_THRESHOLD &&
                               abs(gyroY) < STILL_GYRO_THRESHOLD);

  if (isLayingDownAndStill) {
    if (!isPotentiallySad) {
      isPotentiallySad = true;
      sadStateStartTime = millis();
    }
  } 
  else {
    if (isPotentiallySad) {
      isPotentiallySad = false;
    }
  }

  if (isPotentiallySad && (millis() - sadStateStartTime > SAD_STATE_DURATION_MS)) {
    Serial.println(F("action||3"));
    isPotentiallySad = false;
		feedbackType = 3;
  }
}

//FUNZIONE DI DETECT FEEDBACK COMPLETA
void detectFeedback() {
    readSensors();
    detectShake();
    detectLayDownState();
    detectCaress();
    switch (SlamState) {
      case WAIT_STILL:
        
        if (totalMovementAccel < STILL_MOVEMENT_THRESHOLD) {
          if (millis()-startStill > 700) {
            SlamState = STILL;
          } 
        } else {
          startStill = millis();
        }
        break;

      case STILL:
        if (totalMovementAccel > STILL_MOVEMENT_THRESHOLD) {
          SlamState = LIFT;
          startLift = millis();
          liftf = false;
        }
        break;

      case LIFT:
        if (accelZ+1 < 0) { 
          if (liftf) {
            SlamState = DROP;
            startDrop = millis();
            dropf = false;
          } else {
            SlamState = WAIT_STILL;
          }
        }
        if (millis() - startLift > 500) {
          
            //Serial.println("tempo scaduto");
          SlamState = WAIT_STILL;
        }
        if (abs(accelZ+1) > LIFT_THRESHOLD) {
          //Serial.println("Sono abbastanza veloce!");
          liftf = true;
        }
        break;

        case DROP:
          if (accelZ-1 > 0) {
            //Serial.println("Mi sto muovendo verso il basso!");
            if (dropf) {
              //Serial.println("Dropping terminato!");
              SlamState = STILL_II;
              startStill_II = millis();
            } else {
              SlamState = WAIT_STILL;
            }
          }
          if (millis() - startDrop > 300) {
            SlamState = WAIT_STILL;
          }
          if (abs(accelZ-1) > DROP_THRESHOLD-0.5) {
            //Serial.println("Sono abbastanza veloce! basso");
            dropf = true;
          }
          break;

        case STILL_II:
          //Serial.println("Still_II-Bot!");
            if (millis()-startStill_II > 500) {
              Serial.println(F("action||4"));
              SlamState = WAIT_STILL;
							feedbackType = 4;
            } else if (totalMovementAccel > STILL_MOVEMENT_THRESHOLD+0.5){
              SlamState = WAIT_STILL;
            }
        break;
    }
}



//VARIE ESPRESSIONI (bandite qui per comodità)

const unsigned char Triste1 [] PROGMEM = {
	0x00, 0x90, 0x00, 0x00, 0x00, 0x00, 0xa0, 0x00, 0x00, 0x00, 0xb6, 0x03, 0x00, 0x00, 0x00, 0xae, 
	0x07, 0x00, 0x80, 0x29, 0x1e, 0x00, 0x00, 0x80, 0x18, 0x39, 0x00, 0x20, 0xcb, 0x64, 0x00, 0x00, 
	0x40, 0xd3, 0xcc, 0x00, 0x60, 0xb6, 0x99, 0x00, 0x00, 0x60, 0xb6, 0x66, 0x00, 0xd8, 0x24, 0x6b, 
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	0x30, 0x00, 0x00, 0x80, 0x01, 0x00, 0x00
};

const unsigned char Triste2 [] PROGMEM = {
	0x00, 0x90, 0x00, 0x00, 0x00, 0x00, 0xa0, 0x00, 0x00, 0x00, 0xb6, 0x03, 0x00, 0x00, 0x00, 0xae, 
	0x07, 0x00, 0x80, 0x29, 0x1e, 0x00, 0x00, 0x80, 0x18, 0x39, 0x00, 0x20, 0xcb, 0x64, 0x00, 0x00, 
	0x40, 0xd3, 0xcc, 0x00, 0x60, 0xb6, 0x99, 0x00, 0x00, 0x60, 0xb6, 0x66, 0x00, 0xd8, 0x24, 0x6b, 
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	0x00, 0x00, 0x30, 0x00, 0x00, 0x80, 0x01, 0x00, 0x00
};


const unsigned char Felice1 [] PROGMEM = {
	0x00, 0x00, 0x14, 0x00, 0x00, 0x00, 0x00, 0x24, 0x00, 0x00, 0x00, 0xc0, 0x76, 0x01, 0x00, 0x00, 
	0x80, 0xed, 0x00, 0x00, 0x00, 0x90, 0x22, 0x07, 0x00, 0x00, 0x60, 0x9a, 0x07, 0x00, 0x00, 0x68, 
	0xad, 0x04, 0x00, 0x00, 0xc8, 0x92, 0x0c, 0x00, 0x00, 0x4c, 0xcd, 0x1a, 0x00, 0x00, 0x98, 0xb5, 
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	0x00, 0x00
};

const unsigned char Felice2 [] PROGMEM = {
	0x00, 0x00, 0x50, 0x00, 0x00, 0x00, 0x00, 0x60, 0x00, 0x00, 0x00, 0x00, 0x00, 0xdb, 0x03, 0x00, 
	0x00, 0x00, 0xce, 0x07, 0x00, 0x00, 0x00, 0x80, 0x8c, 0x1c, 0x00, 0x00, 0x80, 0x18, 0x3a, 0x00, 
	0x00, 0x00, 0xa0, 0x65, 0x66, 0x00, 0x00, 0xc0, 0xe6, 0xca, 0x00, 0x00, 0x00, 0x30, 0x35, 0x2b, 
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	0x00, 0x00, 0x00, 0x00, 0x00, 0x00, 0x00, 0x00, 0xc0, 0x7f, 0x00, 0x00, 0x00, 0x00, 0x00
};


const unsigned char Amore1 [] PROGMEM = {
	0x00, 0x90, 0x00, 0x00, 0x00, 0x00, 0xc0, 0x00, 0x00, 0x00, 0xb6, 0x0b, 0x00, 0x00, 0x00, 0x9c, 
	0x0f, 0x00, 0x80, 0x69, 0x1a, 0x00, 0x00, 0x00, 0x31, 0x74, 0x00, 0x20, 0x4b, 0x66, 0x00, 0x00, 
	0x80, 0xcd, 0x95, 0x01, 0x60, 0x9a, 0x99, 0x00, 0x00, 0x40, 0x66, 0x6a, 0x02, 0xc8, 0x66, 0xef, 
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	0x13, 0x00, 0x00, 0x00, 0x00, 
	};
	const unsigned char Amore2 [] PROGMEM = {
	0x00, 0x90, 0x00, 0x00, 0x00, 0x00, 0x20, 0x01, 0x00, 0x00, 0xb6, 0x0b, 0x00, 0x00, 0x00, 0x6c, 
	0x0f, 0x00, 0x80, 0x67, 0x1e, 0x00, 0x00, 0x00, 0x9b, 0x78, 0x00, 0xe0, 0xdf, 0x7f, 0x00, 0x00, 
	0x80, 0xff, 0xfe, 0x01, 0xf0, 0xff, 0xff, 0x00, 0x00, 0xc0, 0xff, 0xff, 0x03, 0xf0, 0xff, 0xff, 
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	0x49, 0x00, 0x00, 0x00, 0x00
};


const unsigned char Rabbia1 [] PROGMEM = {
	0x00, 0x00, 0x00, 0x00, 0x00, 0x00, 0x00, 0x00, 0x00, 0x0e, 0x00, 0x00, 0x00, 0x00, 0x00, 0x00, 
	0x00, 0x00, 0x00, 0x1c, 0x0e, 0x00, 0x00, 0x00, 0x00, 0x00, 0x00, 0x00, 0x00, 0x00, 0x1c, 0x0e, 
	0x00, 0x00, 0x00, 0x00, 0x00, 0x00, 0x00, 0x00, 0x00, 0x3c, 0x0e, 0x00, 0x00, 0x00, 0x00, 0x00, 
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	0x00, 0x00, 0x00, 0x00, 0x00
};

const unsigned char Rabbia2 [] PROGMEM = {
	0x00, 0x00, 0x00, 0x00, 0x00, 0x00, 0x00, 0x00, 0x00, 0x03, 0x00, 0x00, 0x00, 0x00, 0x00, 0x00, 
	0x00, 0x00, 0x30, 0x03, 0x00, 0x00, 0x00, 0x00, 0x00, 0x00, 0x00, 0x00, 0x30, 0x03, 0x00, 0x00, 
	0x00, 0x00, 0x00, 0x00, 0x00, 0x00, 0x60, 0x03, 0x00, 0x00, 0x00, 0x00, 0x00, 0x00, 0x00, 0x00, 
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	0x00, 0x00
};


const unsigned char Sonno1 [] PROGMEM = {
	0x00, 0x00, 0x00, 0x00, 0x00, 0x00, 0x00, 0x00, 0x00, 0x00, 0x00, 0x00, 0x00, 0x00, 0x00, 0x00, 
	0x00, 0x00, 0xe0, 0x00, 0x00, 0x00, 0x00, 0x00, 0x00, 0x00, 0x00, 0x00, 0xe0, 0x07, 0x00, 0x90, 
	0x00, 0x00, 0x00, 0x00, 0x20, 0x01, 0x00, 0x07, 0x00, 0x04, 0x04, 0x00, 0x00, 0x00, 0x04, 0x08, 
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	0x00, 0x00
};

const unsigned char Sonno2 [] PROGMEM = {
	0x00, 0x00, 0x00, 0x00, 0x00, 0x00, 0x00, 0x00, 0x00, 0x30, 0x00, 0x00, 0x00, 0x00, 0x00, 0x00, 
	0x00, 0x00, 0x00, 0x00, 0xf0, 0x00, 0x00, 0x00, 0x00, 0x00, 0x00, 0x00, 0x00, 0x00, 0x00, 0xc0, 
	0x03, 0x00, 0x00, 0x00, 0x00, 0x00, 0x00, 0x00, 0x00, 0x00, 0xc0, 0x01, 0x00, 0x00, 0x00, 0x00, 
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	0x00, 0x00, 0x0e, 0x00, 0x00, 0x00, 0x00, 0x00, 0x00
};


const unsigned char Lettera1 [] PROGMEM = {
	0xfe, 0xff, 0xff, 0xff, 0xff, 0xff, 0x00, 0xfe, 0xff, 0xff, 0xff, 0xff, 0xff, 0x00, 0x1f, 0x00, 
	0x00, 0x00, 0x00, 0xf0, 0x01, 0x3b, 0x00, 0x00, 0x00, 0x00, 0xb8, 0x01, 0xf3, 0x00, 0x00, 0x00, 
	0x00, 0x9e, 0x01, 0xc3, 0x01, 0x00, 0x00, 0x00, 0x87, 0x01, 0x83, 0x07, 0x00, 0x00, 0xc0, 0x83, 
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	0x00, 0xf8, 0x01, 0xfe, 0xff, 0xff, 0xff, 0xff, 0xff, 0x01, 0xfe, 0xff, 0xff, 0xff, 0xff, 0xff, 
	0x00
};

const unsigned char Lettera2 [] PROGMEM = {
	0x00, 0x00, 0xc0, 0x03, 0x00, 0x00, 0x00, 0x00, 0x00, 0xf8, 0x3f, 0x00, 0x00, 0x00, 0x00, 0x80, 
	0x3f, 0xfc, 0x03, 0x00, 0x00, 0x00, 0xf8, 0x07, 0xc0, 0x3f, 0x00, 0x00, 0x80, 0x7f, 0x00, 0x00, 
	0xfc, 0x03, 0x00, 0xf8, 0x07, 0x00, 0x00, 0xe0, 0x1f, 0x00, 0xfe, 0xff, 0xff, 0xff, 0xff, 0xff, 
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	0xff, 0xff, 0xff, 0x01, 0xfe, 0xff, 0xff, 0xff, 0xff, 0xff, 0x00
};


const unsigned char Stordimento1 [] PROGMEM = {
	0x00, 0x20, 0x00, 0x00, 0x00, 0x00, 0x20, 0x01, 0x00, 0x00, 0xee, 0x03, 0x00, 0x00, 0x00, 0x6c, 
	0x07, 0x00, 0x80, 0x09, 0x1d, 0x00, 0x00, 0x00, 0x53, 0x3c, 0x00, 0x20, 0xff, 0x34, 0x00, 0x00, 
	0x40, 0x96, 0x69, 0x00, 0xe0, 0xff, 0xe3, 0x00, 0x00, 0xe0, 0x6c, 0xbf, 0x01, 0xc8, 0xef, 0x4f, 
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	0x00, 0x3f, 0x00, 0x00, 0x00, 0x00, 0x00, 0x00, 0x00, 0x00, 0x1e, 0x00, 0x00, 0x00, 0x00
};

const unsigned char Stordimento2 [] PROGMEM = {
	0x00, 0x20, 0x01, 0x00, 0x00, 0x00, 0x20, 0x01, 0x00, 0x00, 0xb6, 0x0d, 0x00, 0x00, 0x00, 0x6c, 
	0x17, 0x00, 0x80, 0xd4, 0x32, 0x00, 0x00, 0x00, 0xc9, 0x34, 0x00, 0x40, 0xff, 0x9f, 0x00, 0x00, 
	0x80, 0xfd, 0xcf, 0x00, 0x60, 0xff, 0x7f, 0x00, 0x00, 0x40, 0xfe, 0xbf, 0x01, 0x90, 0x4f, 0xfe, 
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	0xc0, 0x7f, 0x00, 0x00, 0x00, 0x00, 0x00, 0x00, 0x00, 0x00, 0x1f, 0x00, 0x00, 0x00, 0x00
};


const unsigned char Normal1 [] PROGMEM = {
	0x00, 0x90, 0x00, 0x00, 0x00, 0x00, 0x20, 0x01, 0x00, 0x00, 0xb6, 0x0b, 0x00, 0x00, 0x00, 0x6c, 
	0x0f, 0x00, 0x80, 0x69, 0x1a, 0x00, 0x00, 0x00, 0xc9, 0x78, 0x00, 0x20, 0x4b, 0x66, 0x00, 0x00, 
	0x80, 0x2d, 0xc3, 0x00, 0x60, 0xd6, 0x99, 0x00, 0x00, 0x40, 0x66, 0x9e, 0x01, 0xd8, 0x94, 0xec, 
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	0x7f, 0x00, 0x00, 0x00, 0x00
};

const unsigned char Normal2 [] PROGMEM = {
	0x00, 0x90, 0x00, 0x00, 0x00, 0x00, 0x20, 0x01, 0x00, 0x00, 0xb6, 0x0b, 0x00, 0x00, 0x00, 0x6c, 
	0x0f, 0x00, 0x80, 0x69, 0x1a, 0x00, 0x00, 0x00, 0xc9, 0x78, 0x00, 0x20, 0x4b, 0x66, 0x00, 0x00, 
	0x80, 0x2d, 0xc3, 0x00, 0x60, 0xd6, 0x99, 0x00, 0x00, 0x40, 0x66, 0x9e, 0x01, 0xd8, 0x94, 0xec, 
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	0x7f, 0x00, 0x00, 0x00, 0x00
};
